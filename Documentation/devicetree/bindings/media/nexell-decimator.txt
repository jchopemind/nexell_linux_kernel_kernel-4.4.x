## Documentation/devicetree/bindings/media/nexell-decimator.txt
```
Nexell V4L2 Device Tree bindings
================================

Decimator can scale down input image and saves to memory.
Normally this function is same to pip-preview function.

Required properties:
- compatible	: must contain "nexell,nx-decimator"
- module	: vip module number
- logical	: whether logical device or not (1 - logical, 0 or none - pysical)
		  logical device is not a real camera device
		  It's just for making a logical video device to use the decimator with another sensor.
- logical_num   : the number of the logical device
		  This value is only valid when logical is TRUE
- status	: to enable, must contain "okay"

Example:
	decimator {
		compatible = "nexell,nx-decimator";
		module = <1>;
		logical = <1>;
		status = "okay";
	};
```
